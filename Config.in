## package/kvpstorage/Config.in
```kconfig
config BR2_PACKAGE_KVPSTORAGE
        bool "KVPstorage"
        help
          This is a key-value pair storage application.
        select BR2_PACKAGE_JSON_FOR_MODERN_CPP
        select BR2_INSTALL_LIBSTDCPP
        select BR2_TOOLCHAIN_HAS_THREADS # boost
        select BR2_PACKAGE_BOOST
        select BR2_PACKAGE_BOOST_SYSTEM
        select BR2_GCC_CROSS_CXX
```
